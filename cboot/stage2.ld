ENTRY(main)
SECTIONS
{    
    . = 0x1000;    
    .text : AT(0x1000)
    {
        _text = .;
        *(.text);
        _text_end = .;
    }
    .data :
    {
        _data = .;
        *(.bss);
        *(.bss*);
        *(.data);
        *(.rodata*);
        *(COMMON)
        _data_end = .;
    }
}
